/*
 * Copyright (C) 2015 MediaTek Inc.
 *
 * This program is free software; you can redistribute it and/or modify
 * it under the terms of the GNU General Public License version 2 as
 * published by the Free Software Foundation.
 *
 * This program is distributed in the hope that it will be useful,
 * but WITHOUT ANY WARRANTY; without even the implied warranty of
 * MERCHANTABILITY or FITNESS FOR A PARTICULAR PURPOSE.
 * See http://www.gnu.org/licenses/gpl-2.0.html for more details.
 */
/*************************
 * Customized Battery Setting dtsi file
*************************/
&bat_comm {
	/* cust_charging.h */

	/* Charging Current Setting */
	usb_charger_current = <50000 >;	/* Unit: 0.01 mA */
	ac_charger_current = <90000 >;	/* Unit: 0.01 mA */
	non_std_ac_charger_current = <50000 >;	/* Unit: 0.01 mA */
	charging_host_charger_current = <65000 >;	/* Unit: 0.01 mA */

	/* charger error check */
	bat_low_temp_protect_enable = <1 >;
	min_charge_temperature=<3>;
	min_charge_temperature_plus_x_degree=<5>;
	max_charge_temperature=<52>;
	max_charge_temperature_minus_x_degree=<50>;
	err_charge_temperature=<100>;
	v_charger_enable = <0 >;	/* 1:on , 0:off */
	v_charger_max = <6500 >;	/* unit: mV */
	v_charger_min = <4400 >;

	recharging_voltage = <4250>;
	/*  Tracking TIME */
	onehundred_percent_tracking_time = <120 >;	/* Unit: second */
	npercent_tracking_time = <20 >;	/* Unit: second */
	sync_to_real_tracking_time = <60 >;	/* Unit: second */
	v_0percent_tracking = <3400 >;	/* Unit: mV */

	/* High battery support */
	high_battery_voltage_support = <1>;

	/* cust_battery_meter.h */
	/* ADC resistor  */
	r_bat_sense = <4 >;
	r_i_sense = <4 >;
	r_charger_1 = <330 >;
	r_charger_2 = <39 >;
	temperature_t0 = <110 >;
	temperature_t1 = <0 >;
	temperature_t2 = <25 >;
	temperature_t3 = <50 >;
	temperature_t = <255 >;	/* this should be fixed, never change the value */
	fg_meter_resistance = <0 >;
};

&bat_meter {
	/* Qmax for 0mA */
	q_max_pos_50 = <4120 >;
	q_max_pos_25 = <4055 >;
	q_max_pos_0 = <4054 >;
	q_max_neg_10 = <3948 >;
	/* Qmax for 400mA, said high current */
	q_max_pos_50_h_current = <4006 >;
	q_max_pos_25_h_current = <4043 >;
	q_max_pos_0_h_current = <3844 >;
	q_max_neg_10_h_current = <2923 >;
	/* Discharge percentage, 1: D5, 0: D2 */
	oam_d5 = <1 >;

	change_tracking_point = <1 >;
	/* SW OCV tracking setting */
	cust_tracking_point = <1 >;
	cust_r_sense = <30>;
	cust_hw_cc = <0 >;
	aging_tuning_value = <103 >;
	cust_r_fg_offset = <0 >;
	ocv_board_compesate = <0 >;
	r_fg_board_base = <1000 >;
	r_fg_board_slope = <1000 >;
	car_tune_value = <100 >;

	/* HW Fuel gague  */
	current_detect_r_fg = <10 >;	/* Unit: mA */
	minerroroffset = <1000 >;
	fg_vbat_average_size = <18 >;
	r_fg_value = <10 >;	/* Unit: mOhm */

	cust_poweron_delta_capacity_tolrance = <40 >;
	cust_poweron_low_capacity_tolrance = <5 >;
	cust_poweron_max_vbat_tolrance = <90 >;
	cust_poweron_delta_vbat_tolrance = <30 >;
	cust_poweron_delta_hw_sw_ocv_capacity_tolrance = <10 >;

	/* Fixed battery temperature */
	fixed_tbat_25 = <0 >;
	/* Dynamic change wake up period of battery thread when suspend */
	vbat_normal_wakeup = <3600 >;	/* Unit: mV */
	vbat_low_power_wakeup = <3500 >;	/* Unit: mV */
	normal_wakeup_period = <5400 >;	/* Unit: second */
	low_power_wakeup_period = <300 >;	/* Unit: second */
	close_poweroff_wakeup_period = <30 >;	/* Unit: second */

	rbat_pull_up_r = <16900 >;
	rbat_pull_up_d = <27000 >;
	rbat_pull_up_volt = <1800 >;

	batt_temperature_table_num = <17 >;
	batt_temperature_table = <
			    (-20) 83104
			    (-15) 71753
			    (-10) 52118
			    (-5) 41188
			    0 31133
			    5 23751
			    10 18880
			    15 14872
			    20 12400
			    25 10561 30 8315 35 6948 40 5834 45 4917 50 4161 55 3535 60 3014 >;

	battery_profile_t0_num = <82 >;
	battery_profile_t0 = 
	            <0   4342 
				 1   4321 
				 3   4299 
				 4   4281 
				 5   4265 
				 6   4248 
				 8   4232 
				 9   4217 
				 10  4202 
				 11  4187 
				 13  4171 
				 14  4158 
				 15  4144 
				 16  4129 
				 18  4114 
				 19  4101 
				 20  4089 
				 22  4077 
				 23  4064 
				 24  4049 
				 25  4028 
				 27  4006 
				 28  3988 
				 29  3973 
				 30  3961 
				 32  3950 
				 33  3940 
				 34  3932 
				 35  3924 
				 37  3915 
				 38  3906 
				 39  3897 
				 41  3887 
				 42  3879 
				 43  3871 
				 44  3863 
				 46  3856 
				 47  3848 
				 48  3842 
				 49  3836 
				 51  3827 
				 52  3822 
				 53  3816 
				 54  3811 
				 56  3805 
				 57  3802 
				 58  3796 
				 60  3793 
				 61  3789 
				 62  3787 
				 63  3784 
				 65  3781  
				 66  3778 
				 67  3777 
				 68  3775 
				 70  3771 
				 71  3768 
				 72  3766 
				 73  3764 
				 75  3761 
				 76  3757 
				 77  3753 
				 79  3750 
				 80  3745 
				 81  3741 
				 82  3735 
				 84  3729 
				 85  3723 
				 86  3717 
				 87  3710 
				 89  3704 
				 90  3699 
				 91  3693 
				 92  3686 
				 94  3680 
				 95  3668 
				 96  3648 
				 98  3618 
				 99  3570 
				 99  3509 
				 99  3475 
				 100 3400 
>;

	battery_profile_t1_num = <82 >;
	battery_profile_t1 = 
	     <0   4370
				1   4352
				2   4335
				4   4320
				5   4304
				6   4289
				7   4273
				9   4259
				10  4244
				11  4229
				12  4215
				14  4201
				15  4187
				16  4173
				17  4159
				19  4146
				20  4132
				21  4119
				22  4105
				23  4092
				25  4082
				26  4073
				27  4060
				28  4043
				30  4022
				31  4003
				32  3987
				33  3975
				35  3964
				36  3955
				37  3944
				38  3935
				39  3924
				41  3914
				42  3903
				43  3893
				44  3882
				46  3873
				47  3864
				48  3857
				49  3850
				51  3842
				52  3836
				53  3829
				54  3823
				56  3818
				57  3813
				58  3808
				59  3805
				60  3800
				62  3796
				63  3792
				64  3790
				65  3787
				67  3783
				68  3780
				69  3778
				70  3777
				72  3775
				73  3771
				74  3771
				75  3768
				76  3765
				78  3762
				79  3759
				80  3756
				81  3750
				83  3744
				84  3738
				85  3732
				86  3725
				88  3716
				89  3707
				90  3699
				91  3694
				93  3689
				94  3686
				95  3680
				96  3668
				97  3633
				99  3571
				100 3400
				>;

	battery_profile_t2_num = <82 >;
	battery_profile_t2 = 
	     <0   4363
				1   4346
				2   4331
				4   4316
				5   4299
				6   4285
				7   4269
				9   4255
				10  4238
				11  4225
				12  4211
				14  4196
				15  4181
				16  4167
				17  4153
				18  4139
				20  4125
				21  4109
				22  4098
				23  4085
				25  4073
				26  4061
				27  4052
				28  4038
				30  4021
				31  4006
				32  3993
				33  3984
				35  3975
				36  3967
				37  3958
				38  3946
				39  3938
				41  3926
				42  3915
				43  3902
				44  3887
				46  3873
				47  3863
				48  3853
				49  3845
				51  3838
				52  3831
				53  3825
				54  3820
				55  3814
				57  3809
				58  3805
				59  3800
				60  3796
				62  3792
				63  3788
				64  3785
				65  3781
				67  3780
				68  3776
				69  3770
				70  3770
				72  3767
				73  3763
				74  3759
				75  3755
				76  3751
				78  3747
				79  3741
				80  3738
				81  3733
				83  3729
				84  3723
				85  3714
				86  3707
				88  3700
				89  3689
				90  3683
				91  3682
				92  3680
				94  3678
				95  3675
				96  3663
				97  3617
				99  3548
				100 3400
             >;


	battery_profile_t3_num = <82>;
	battery_profile_t3 = 
	     <0   4360
				1   4342
				2   4327
				4   4312
				5   4296
				6   4281
				7   4266
				8   4251
				10  4235
				11  4221
				12  4207
				13  4193
				15  4177
				16  4164
				17  4150
				18  4136
				19  4122
				21  4108
				22  4095
				23  4083
				24  4070
				25  4056
				27  4044
				28  4032
				29  4021
				30  4010
				32  3997
				33  3987
				34  3976
				35  3966
				36  3955
				38  3945
				39  3934
				40  3924
				41  3912
				42  3900
				44  3886
				45  3873
				46  3863
				47  3854
				49  3848
				50  3840
				51  3834
				52  3827
				53  3822
				55  3816
				56  3811
				57  3806
				58  3802
				59  3798
				61  3793
				62  3790
				63  3786
				64  3783
				66  3780
				67  3777
				68  3773
				69  3768
				70  3762
				72  3753
				73  3747
				74  3743
				75  3738
				76  3733
				78  3729
				79  3725
				80  3721
				81  3716
				83  3707
				84  3701
				85  3693
				86  3683
				87  3676
				89  3674
				90  3674
				91  3671
				92  3668
				93  3659
				95  3619
				96  3558
				97  3469
				100 3400
			>;

	r_profile_t0_num = <82>;
	r_profile_t0 = 
	      <1015 4342 
				 1015 4321 
				 998  4299 
				 985  4281 
				 970  4265 
				 953  4248 
				 938  4232 
				 928  4217 
				 915  4202 
				 903  4187 
				 893  4171 
				 883  4158 
				 875  4144 
				 865  4129 
				 858  4114 
				 848  4101 
				 843  4089 
				 840  4077 
				 838  4064 
				 835  4049
				 817  4028 
				 800  4006 
				 788  3988 
				 778  3973 
				 780  3961 
				 775  3950 
				 773  3940 
				 775  3932 
				 773  3924 
				 770  3915 
				 768  3906 
				 768  3897 
				 763  3887 
				 765  3879 
				 765  3871 
				 763  3863 
				 768  3856 
				 765  3848 
				 773  3842 
				 773  3836 
				 773  3827 
				 775  3822 
				 775  3816 
				 780  3811 
				 783  3805 
				 790  3802 
				 790  3796 
				 798  3793 
				 800  3789 
				 810  3787 
				 813  3784 
				 818  3781 
				 825  3778  
				 838  3777 
				 845  3775 
				 853  3771 
				 860  3768 
				 880  3766 
				 898  3764 
				 918  3761 
				 935  3757 
				 960  3753 
				 995  3750 
				 1025 3745 
				 1068 3741 
				 1115 3735 
				 1175 3729 
				 1245 3723 
				 1328 3717 
				 1418 3710 
				 1498 3704 
				 1573 3699 
				 1633 3693 
				 1685 3686 
				 1750 3680 
				 1820 3668 
				 1898 3648 
				 2013 3618 
				 2190 3570 
				 2038 3509 
				 1953 3475 
				 1765 3400 
>;

	r_profile_t1_num = <82>;
	r_profile_t1 = <
	      330     4370
				330     4352
				325     4335
				325     4320
				325     4304
				325     4289
				320     4273
				320     4259
				325     4244
				323     4229
				322     4215
				325     4201
				325     4187
				325     4173
				325     4159
				330     4146
				333     4132
				335     4119
				335     4105
				335     4092
				340     4082
				345     4073
				347     4060
				350     4043
				345     4022
				338     4003
				335     3987
				333     3975
				330     3964
				335     3955
				330     3944
				325     3935
				320     3924
				318     3914
				313     3903
				313     3893
				308     3882
				305     3873
				300     3864
				300     3857
				303     3850
				298     3842
				300     3836
				300     3829
				298     3823
				300     3818
				303     3813
				305     3808
				310     3805
				308     3800
				310     3796
				310     3792
				315     3790
				320     3787
				320     3783
				320     3780
				323     3778
				328     3777
				328     3775
				328     3771
				333     3771
				333     3768
				335     3765
				343     3762
				343     3759
				350     3756
				353     3750
				360     3744
				368     3738
				375     3732
				388     3725
				400     3716
				415     3707
				438     3699
				468     3694
				518     3689
				595     3686
				718     3680
				925     3668
				1255    3633
				1505    3571
				1503    3400			  
	>;

	r_profile_t2_num = <82 >;
	r_profile_t2 = 
	     <68  4363
				108 4346
				108 4331
				108 4316
				105 4299
				108 4285
				105 4269
				108 4255
				103 4238
				108 4225
				110 4211
				108 4196
				108 4181
				110 4167
				110 4153
				110 4139
				110 4125
				108 4109
				115 4098
				115 4085
				120 4073
				120 4061
				125 4052
				125 4038
				123 4021
				125 4006
				128 3993
				133 3984
				133 3975
				135 3967
				138 3958
				138 3946
				145 3938
				140 3926
				140 3915
				135 3902
				123 3887
				115 3873
				113 3863
				108 3853
				108 3845
				105 3838
				103 3831
				105 3825
				108 3820
				108 3814
				108 3809
				110 3805
				108 3800
				110 3796
				110 3792
				110 3788
				113 3785
				110 3781
				118 3780
				115 3776
				105 3770
				115 3770
				113 3767
				110 3763
				110 3759
				110 3755
				108 3751
				110 3747
				105 3741
				108 3738
				105 3733
				108 3729
				108 3723
				105 3714
				105 3707
				108 3700
				108 3689
				108 3683
				113 3682
				113 3680
				118 3678
				123 3675
				125 3663
				120 3617
				130 3548
				40  3400				
				>;

	r_profile_t3_num = <82>;
	r_profile_t3 =
	     <83  4360
				83  4342
				85  4327
				88  4312
				85  4296
				85  4281
				88  4266
				85  4251
				83  4235
				85  4221
				88  4207
				88  4193
				83  4177
				88  4164
				88  4150
				88  4136
				90  4122
				85  4108
				90  4095
				92  4083
				90  4070
				90  4056
				93  4044
				95  4032
				98  4021
				100 4010
				95  3997
				98  3987
				100 3976
				105 3966
				103 3955
				105 3945
				105 3934
				108 3924
				108 3912
				105 3900
				95  3886
				88  3873
				88  3863
				85  3854
				90  3848
				88  3840
				88  3834
				85  3827
				88  3822
				85  3816
				85  3811
				88  3806
				93  3802
				90  3798
				93  3793
				93  3790
				93  3786
				95  3783
				98  3780
				98  3777
				95  3773
				93  3768
				90  3762
				83  3753
				85  3747
				90  3743
				90  3738
				88  3733
				88  3729
				90  3725
				88  3721
				90  3716
				83  3707
				90  3701
				85  3693
				88  3683
				88  3676
				85  3674
				93  3674
				93  3671
				100 3668
				100 3659
				93  3619
				100 3558
				113 3469
				338 3400				
				>;
};
