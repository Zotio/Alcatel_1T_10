## drivers/misc/mediatek/dtv/Kconfig
```kconfig
menu "DTV Configure"

config DTV_FC8180_SUPPORT
	bool "CONFIG_DTV_FC8180_SUPPORT"
	default n

endmenu
```

## drivers/misc/mediatek/sensors-1.0/accelerometer/msa3016/Kconfig
```kconfig
config MTK_MSA3016
	tristate "MSA3016 for MediaTek package"
	default n
	help
	  It support different accelerometer sensor.
          If this option is set,
	  it will support
          MSA300 Accelerometer.
```
