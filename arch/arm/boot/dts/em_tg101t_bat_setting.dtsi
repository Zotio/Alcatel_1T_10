/*
 * Copyright (C) 2015 MediaTek Inc.
 *
 * This program is free software; you can redistribute it and/or modify
 * it under the terms of the GNU General Public License version 2 as
 * published by the Free Software Foundation.
 *
 * This program is distributed in the hope that it will be useful,
 * but WITHOUT ANY WARRANTY; without even the implied warranty of
 * MERCHANTABILITY or FITNESS FOR A PARTICULAR PURPOSE.
 * See http://www.gnu.org/licenses/gpl-2.0.html for more details.
 */
/*************************
 * Customized Battery Setting dtsi file
*************************/
&bat_comm {
	/* cust_charging.h */

	/* Charging Current Setting */
	usb_charger_current = <50000 >;	/* Unit: 0.01 mA */
	ac_charger_current = <120000 >;	/* Unit: 0.01 mA */
	non_std_ac_charger_current = <50000 >;	/* Unit: 0.01 mA */
	charging_host_charger_current = <65000 >;	/* Unit: 0.01 mA */

	/* charger error check */
	bat_low_temp_protect_enable = <1 >;
	min_charge_temperature=<3>;
	min_charge_temperature_plus_x_degree=<5>;
	max_charge_temperature=<52>;
	max_charge_temperature_minus_x_degree=<50>;
	err_charge_temperature=<100>;
	v_charger_enable = <0 >;	/* 1:on , 0:off */
	v_charger_max = <6500 >;	/* unit: mV */
	v_charger_min = <4400 >;

	/*  Tracking TIME */
	onehundred_percent_tracking_time = <10 >;	/* Unit: second */
	npercent_tracking_time = <20 >;	/* Unit: second */
	sync_to_real_tracking_time = <60 >;	/* Unit: second */
	v_0percent_tracking = <3400 >;	/* Unit: mV */

	/* High battery support */
	high_battery_voltage_support = <1>;

	/* cust_battery_meter.h */
	/* ADC resistor  */
	r_bat_sense = <4 >;
	r_i_sense = <4 >;
	r_charger_1 = <330 >;
	r_charger_2 = <39 >;
	temperature_t0 = <110 >;
	temperature_t1 = <0 >;
	temperature_t2 = <25 >;
	temperature_t3 = <50 >;
	temperature_t = <255 >;	/* this should be fixed, never change the value */
	fg_meter_resistance = <0 >;
};

&bat_meter {
	/* Qmax for 0mA */
	q_max_pos_50 = <4138 >;
	q_max_pos_25 = <4149 >;
	q_max_pos_0 = <4108 >;
	q_max_neg_10 = <4123 >;
	/* Qmax for 400mA, said high current */
	q_max_pos_50_h_current = <4109 >;
	q_max_pos_25_h_current = <4105 >;
	q_max_pos_0_h_current = <3311 >;
	q_max_neg_10_h_current = <1196 >;
	/* Discharge percentage, 1: D5, 0: D2 */
	oam_d5 = <1 >;

	change_tracking_point = <1 >;
	/* SW OCV tracking setting */
	cust_tracking_point = <1 >;
	cust_r_sense = <30>;
	cust_hw_cc = <0 >;
	aging_tuning_value = <103 >;
	cust_r_fg_offset = <0 >;
	ocv_board_compesate = <0 >;
	r_fg_board_base = <1000 >;
	r_fg_board_slope = <1000 >;
	car_tune_value = <100 >;

	/* HW Fuel gague  */
	current_detect_r_fg = <10 >;	/* Unit: mA */
	minerroroffset = <1000 >;
	fg_vbat_average_size = <18 >;
	r_fg_value = <10 >;	/* Unit: mOhm */

	cust_poweron_delta_capacity_tolrance = <40 >;
	cust_poweron_low_capacity_tolrance = <5 >;
	cust_poweron_max_vbat_tolrance = <90 >;
	cust_poweron_delta_vbat_tolrance = <30 >;
	cust_poweron_delta_hw_sw_ocv_capacity_tolrance = <10 >;

	/* Fixed battery temperature */
	fixed_tbat_25 = <0 >;
	/* Dynamic change wake up period of battery thread when suspend */
	vbat_normal_wakeup = <3600 >;	/* Unit: mV */
	vbat_low_power_wakeup = <3500 >;	/* Unit: mV */
	normal_wakeup_period = <5400 >;	/* Unit: second */
	low_power_wakeup_period = <300 >;	/* Unit: second */
	close_poweroff_wakeup_period = <30 >;	/* Unit: second */

	rbat_pull_up_r = <16900 >;
	rbat_pull_up_d = <27000 >;
	rbat_pull_up_volt = <1800 >;

	batt_temperature_table_num = <17 >;
	batt_temperature_table = <
			    (-20) 68237
			    (-15) 53650
			    (-10) 42506
			    (-5) 33892
			    0 27219
			    5 22021
			    10 17926
			    15 14674
			    20 12081
			    25 10000 30 8315 35 6948 40 5834 45 4917 50 4161 55 3535 60 3014 >;

	battery_profile_t0_num = <102 >;
	battery_profile_t0 = <0 4378 
				 1 4356 
				 2 4339 
				 3 4324 
				 4 4310 
				 5 4295 
				 6 4285 
				 7 4273 
				 8 4262 
				 9 4250 
				 10 4238 
				 11 4225 
				 12 4216 
				 13 4205 
				 14 4197 
				 15 4185 
				 16 4175 
				 17 4164 
				 18 4153 
				 19 4138 
				 20 4123 
				 21 4113 
				 22 4104 
				 23 4095 
				 24 4087 
				 25 4079 
				 26 4073 
				 27 4062 
				 28 4050 
				 29 4032 
				 30 4016 
				 31 4001 
				 32 3988 
				 33 3978 
				 34 3970 
				 35 3961 
				 36 3954 
				 37 3949 
				 38 3942 
				 39 3935 
				 40 3927 
				 41 3918 
				 42 3911 
				 43 3902 
				 44 3895 
				 45 3886 
				 46 3879 
				 47 3871 
				 48 3865 
				 49 3858 
				 50 3853 
				 51 3847  
				 52 3840 
				 53 3833 
				 54 3828 
				 55 3824 
				 56 3820 
				 57 3815 
				 58 3811 
				 59 3808 
				 60 3804 
				 61 3802 
				 62 3799 
				 63 3795 
				 64 3793 
				 65 3791 
				 66 3789 
				 67 3786 
				 68 3785 
				 69 3783 
				 70 3783 
				 71 3781 
				 72 3780 
				 73 3778 
				 74 3777 
				 75 3774 
				 76 3772 
				 77 3770 
				 78 3767 
				 79 3764 
				 80 3761 
				 81 3757 
				 82 3754 
				 83 3745  
				 84 3737 
				 85 3729 
				 86 3724 
				 87 3718 
				 88 3709 
				 89 3705 
				 90 3699 
				 91 3696 
				 92 3692 
				 93 3692 
				 94 3687 
				 95 3680 
				 96 3666 
				 97 3637 
				 98 3589 
				 99 3484 
				 100 3400 
				 100 3400 >;

	battery_profile_t1_num = <102 >;
	battery_profile_t1 = <0 4386
				1 4369
				2 4356
				3 4342
				4 4327
				5 4316
				6 4300
				7 4290
				8 4279
				9 4267
				10 4257
				11 4245
				12 4233
				13 4224
				14 4213
				15 4202
				16 4191
				17 4180
				18 4170
				19 4156
				20 4140
				21 4128
				22 4117
				23 4107
				24 4097
				25 4090
				26 4082
				27 4075
				28 4067
				29 4053
				30 4037
				31 4019
				32 4003
				33 3990
				34 3978
				35 3968
				36 3961
				37 3953
				38 3946
				39 3939
				40 3932
				41 3923
				42 3913
				43 3907
				44 3897
				45 3889
				46 3883
				47 3874
				48 3868
				49 3863
				50 3856
				51 3850
				52 3846
				53 3840
				54 3836
				55 3831
				56 3825
				57 3819
				58 3815
				59 3811
				60 3808
				61 3804
				62 3802
				63 3798
				64 3795
				65 3793
				66 3790
				67 3787
				68 3787
				69 3784
				70 3783
				71 3782
				72 3781
				73 3779
				74 3777
				75 3775
				76 3773
				77 3770
				78 3767
				79 3764
				80 3761
				81 3756
				82 3751
				83 3746
				84 3740
				85 3735
				86 3728
				87 3721
				88 3713
				89 3707
				90 3702
				91 3700
				92 3696
				93 3693
				94 3686
				95 3673
				96 3650
				97 3611
				98 3556
				99 3479
				100 3400
				100 3400
				>;

	battery_profile_t2_num = <102 >;
	battery_profile_t2 = <0 4388
				1 4374
				2 4363
				3 4351
				4 4338
				5 4329
				6 4320
				7 4307
				8 4293
				9 4284
				10 4273
				11 4262
				12 4249
				13 4238
				14 4221
				15 4206
				16 4191
				17 4183
				18 4172
				19 4161
				20 4151
				21 4140
				22 4127
				23 4117
				24 4108
				25 4099
				26 4087
				27 4079
				28 4070
				29 4064
				30 4055
				31 4044
				32 4028
				33 4015
				34 4004
				35 3995
				36 3990
				37 3984
				38 3978
				39 3971
				40 3964
				41 3956
				42 3945
				43 3931
				44 3911
				45 3900
				46 3889
				47 3881
				48 3872
				49 3868
				50 3862
				51 3856
				52 3850
				53 3845
				54 3839
				55 3835
				56 3831
				57 3828
				58 3823
				59 3818
				60 3815
				61 3812
				62 3807
				63 3805
				64 3802
				65 3798
				66 3796
				67 3793
				68 3790
				69 3787
				70 3785
				71 3782
				71 3779
				72 3775
				73 3771
				74 3769
				75 3763
				76 3762
				77 3758
				78 3753
				79 3749
				80 3746
				81 3742
				82 3738
				83 3732
				84 3727
				85 3722
				86 3717
				87 3711
				88 3701
				89 3694
				90 3691
				91 3691
				92 3690
				93 3689
				94 3688
				95 3684
				96 3675
				97 3645
				98 3569
				99 3458
				100 3400>;


	battery_profile_t3_num = <102>;
	battery_profile_t3 = <0 4368
				1 4359
				2 4344
				3 4334
				4 4325
				5 4317
				6 4306
				7 4295
				8 4282
				9 4268
				10 4255
				11 4245
				12 4234
				13 4224
				14 4211
				15 4194
				16 4183
				17 4170
				18 4155
				19 4147
				20 4136
				21 4127
				22 4119
				23 4108
				24 4098
				25 4088
				26 4074
				27 4066
				28 4054
				29 4045
				30 4035
				31 4029
				32 4021
				33 4010
				34 4002
				35 3991
				36 3983
				37 3975
				38 3965
				39 3959
				40 3953
				41 3947
				42 3938
				43 3921
				44 3899
				45 3889
				46 3879
				47 3869
				48 3865
				49 3859
				50 3853
				51 3847
				52 3839
				53 3833
				54 3833
				55 3826
				56 3821
				57 3819
				58 3811
				59 3807
				60 3804
				61 3799
				62 3797
				63 3795
				64 3791
				65 3786
				66 3785
				67 3783
				68 3777
				69 3775
				70 3772
				71 3770
				72 3763
				73 3750
				74 3749
				75 3745
				76 3741
				77 3735
				78 3729
				79 3725
				80 3722
				81 3720
				82 3715
				83 3714
				84 3709
				85 3701
				86 3696
				87 3689
				88 3678
				89 3673
				90 3671
				91 3671
				92 3672
				93 3673
				94 3670
				95 3667
				96 3655
				97 3626
				98 3581
				99 3525
				100 3400
				100 3400>;

	r_profile_t0_num = <102>;
	r_profile_t0 = <784 4378 
				 784 4356 
				 790 4339 
				 794 4324 
				 797 4310 
				 795 4295 
				 796 4285 
				 794 4273 
				 793 4262 
				 793 4250 
				 793 4238 
				 789 4225 
				 789 4216 
				 783 4205 
				 780 4197 
				 775 4185 
				 778 4175 
				 779 4164 
				 776 4153 
				 773 4138
				 769 4123 
				 769 4113 
				 770 4104 
				 771 4095 
				 771 4087 
				 768 4079 
				 765 4073 
				 760 4062 
				 794 4050 
				 794 4032 
				 790 4016 
				 785 4001 
				 781 3988 
				 780 3978 
				 778 3970 
				 777 3961 
				 778 3954 
				 778 3949 
				 775 3942 
				 767 3935 
				 763 3927 
				 758 3918 
				 761 3911 
				 759 3902 
				 758 3895 
				 754 3886 
				 753 3879 
				 751 3871 
				 750 3865 
				 749 3858 
				 751 3853 
				 749 3847 
				 746 3840  
				 745 3833 
				 744 3828 
				 749 3824 
				 748 3820 
				 748 3815 
				 746 3811 
				 749 3808 
				 748 3804 
				 754 3802 
				 755 3799 
				 755 3795 
				 755 3793 
				 754 3791 
				 752 3789 
				 753 3786 
				 756 3785 
				 760 3783 
				 763 3783 
				 765 3781 
				 767 3780 
				 771 3778 
				 776 3777 
				 779 3774 
				 783 3772 
				 787 3770 
				 789 3767 
				 790 3764 
				 795 3761 
				 803 3757 
				 807 3754 
				 820 3745  
				 830 3737 
				 838 3729 
				 851 3724 
				 864 3718 
				 876 3709 
				 893 3705 
				 906 3699 
				 926 3696 
				 944 3692 
				 975 3692 
				 1002 3687 
				 1042 3680 
				 1080 3666 
				 1111 3637 
				 1140 3589 
				 1136 3484 
				 1206 3400 
				 1221 3400>;

	r_profile_t1_num = <102>;
	r_profile_t1 = <470 4386
				470 4369
				485 4356
				497 4342
				493 4327
				491 4316
				485 4300
				486 4290
				490 4279
				490 4267
				487 4257
				484 4245
				479 4233
				458 4224
				458 4213
				451 4202
				466 4191
				466 4180
				462 4170
				458 4156
				459 4140
				458 4128
				457 4117
				453 4107
				454 4097
				452 4090
				434 4082
				438 4075
				428 4067
				449 4053
				443 4037
				433 4019
				426 4003
				428 3990
				427 3978
				426 3968
				426 3961
				425 3953
				426 3946
				408 3939
				401 3932
				393 3923
				392 3913
				407 3907
				401 3897
				397 3889
				398 3883
				398 3874
				402 3868
				403 3863
				404 3856
				404 3850
				403 3846
				384 3840
				386 3836
				381 3831
				394 3827
				397 3825
				399 3815
				401 3811
				407 3808
				408 3804
				410 3802
				411 3798
				409 3795
				412 3793
				392 3790
				396 3787
				395 3787
				412 3784
				417 3783
				420 3782
				424 3781
				426 3779
				431 3777
				434 3775
				395 3773
				438 3770
				441 3767
				444 3764
				443 3761
				448 3756
				443 3751
				475 3746
				485 3740
				495 3735
				503 3728
				515 3721
				526 3713
				544 3707
				560 3702
				588 3700
				612 3696
				632 3693
				672 3686
				727 3673
				791 3650
				841 3611
				891 3556
				954 3479
				1046 3400
				4202 3400>;

	r_profile_t2_num = <102 >;
	r_profile_t2 = <117 4388
				117 4374
				115 4363
				115 4351
				116 4338
				116 4329
				119 4320
				119 4307
				115 4293
				119 4284
				118 4273
				119 4262
				117 4249
				119 4238
				120 4221
				122 4206
				114 4191
				117 4183
				118 4172
				118 4161
				120 4151
				121 4140
				117 4127
				119 4117
				121 4108
				123 4099
				121 4087
				125 4079
				125 4070
				130 4064
				128 4055
				128 4044
				127 4028
				122 4015
				124 4004
				122 3995
				126 3990
				127 3984
				125 3978
				125 3971
				126 3964
				128 3956
				124 3945
				122 3931
				117 3911
				115 3900
				111 3889
				111 3881
				107 3872
				110 3868
				109 3862
				109 3856
				107 3850
				107 3845
				108 3839
				111 3835
				109 3831
				110 3828
				110 3823
				107 3818
				111 3815
				109 3812
				109 3807
				112 3805
				111 3802
				111 3798
				114 3796
				113 3793
				113 3790
				114 3787
				114 3785
				114 3782
				113 3779
				112 3775
				111 3771
				114 3769
				110 3763
				110 3762
				111 3758
				109 3753
				108 3749
				111 3746
				111 3742
				110 3738
				108 3732
				111 3727
				112 3722
				112 3717
				112 3711
				111 3701
				112 3694
				109 3691
				112 3691
				111 3690
				114 3689
				119 3688
				121 3684
				122 3675
				119 3645
				123 3569
				129 3458
				147 3400>;

	r_profile_t3_num = <102>;
	r_profile_t3 = <85 4368
				85 4359
				80 4344
				77 4334
				81 4325
				84 4317
				78 4306
				79 4295
				78 4282
				76 4268
				78 4255
				81 4245
				81 4234
				80 4224
				82 4211
				79 4194
				81 4183
				80 4170
				81 4155
				86 4147
				82 4136
				83 4127
				84 4119
				80 4108
				82 4098
				84 4088
				81 4074
				86 4066
				83 4054
				86 4045
				84 4035
				89 4029
				85 4021
				84 4010
				88 4002
				85 3991
				90 3983
				90 3975
				88 3965
				97 3959
				95 3953
				94 3947
				92 3938
				89 3921
				85 3899
				85 3889
				82 3879
				76 3869
				82 3865
				79 3859
				78 3853
				79 3847
				75 3839
				78 3833
				84 3833
				78 3826
				78 3821
				82 3819
				75 3811
				78 3807
				80 3804
				79 3799
				83 3797
				83 3795
				81 3791
				80 3786
				84 3785
				84 3783
				81 3777
				84 3775
				82 3772
				85 3770
				81 3763 
				77 3750
				82 3749
				78 3745
				77 3741
				74 3735
				75 3729
				78 3725
				79 3722
				80 3720
				79 3715
				82 3714
				78 3709
				76 3701
				78 3696
				77 3689
				75 3678
				81 3673
				76 3671
				81 3671
				84 3672
				84 3673
				82 3670
				86 3667
				84 3655
				83 3626
				79 3581
				84 3525
				89 3400
				103 3400>;
};
