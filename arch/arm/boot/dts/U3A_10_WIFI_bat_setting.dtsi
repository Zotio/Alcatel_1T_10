/*
 * Copyright (C) 2015 MediaTek Inc.
 *
 * This program is free software; you can redistribute it and/or modify
 * it under the terms of the GNU General Public License version 2 as
 * published by the Free Software Foundation.
 *
 * This program is distributed in the hope that it will be useful,
 * but WITHOUT ANY WARRANTY; without even the implied warranty of
 * MERCHANTABILITY or FITNESS FOR A PARTICULAR PURPOSE.
 * See http://www.gnu.org/licenses/gpl-2.0.html for more details.
 */
/*************************
 * Customized Battery Setting dtsi file
*************************/
&bat_comm {
	/* cust_charging.h */

	/* Charging Current Setting */
	usb_charger_current = <50000 >;	/* Unit: 0.01 mA */
	ac_charger_current = <90000 >;	/* Unit: 0.01 mA */
	non_std_ac_charger_current = <50000 >;	/* Unit: 0.01 mA */
	charging_host_charger_current = <65000 >;	/* Unit: 0.01 mA */

	/* charger error check */
	bat_low_temp_protect_enable = <1 >;
	min_charge_temperature=<3>;
	min_charge_temperature_plus_x_degree=<5>;
	max_charge_temperature=<52>;
	max_charge_temperature_minus_x_degree=<50>;
	err_charge_temperature=<100>;
	v_charger_enable = <0 >;	/* 1:on , 0:off */
	v_charger_max = <6500 >;	/* unit: mV */
	v_charger_min = <4400 >;

	recharging_voltage = <4280>;
	/*  Tracking TIME */
	onehundred_percent_tracking_time = <120 >;	/* Unit: second */
	npercent_tracking_time = <20 >;	/* Unit: second */
	sync_to_real_tracking_time = <60 >;	/* Unit: second */
	v_0percent_tracking = <3400 >;	/* Unit: mV */

	/* High battery support */
	high_battery_voltage_support = <1>;

	/* cust_battery_meter.h */
	/* ADC resistor  */
	r_bat_sense = <4 >;
	r_i_sense = <4 >;
	r_charger_1 = <330 >;
	r_charger_2 = <39 >;
	temperature_t0 = <110 >;
	temperature_t1 = <0 >;
	temperature_t2 = <25 >;
	temperature_t3 = <50 >;
	temperature_t = <255 >;	/* this should be fixed, never change the value */
	fg_meter_resistance = <0 >;
};

&bat_meter {
	/* Qmax for 0mA */
	q_max_pos_50 = <4138 >;
	q_max_pos_25 = <4149 >;
	q_max_pos_0 = <4108 >;
	q_max_neg_10 = <4123 >;
	/* Qmax for 400mA, said high current */
	q_max_pos_50_h_current = <4109 >;
	q_max_pos_25_h_current = <4105 >;
	q_max_pos_0_h_current = <3311 >;
	q_max_neg_10_h_current = <1196 >;
	
	/* Qmax for BYD 0mA */
	q_max_pos_byd_50 = <4023 >;
	q_max_pos_byd_25 = <4070 >;
	q_max_pos_byd_0 = <3950 >;
	q_max_neg_byd_10 = <2950 >;
	/* Qmax for BYD 400mA, said high current */
	q_max_pos_byd_50_h_current = <4008 >;
	q_max_pos_byd_25_h_current = <4043 >;
	q_max_pos_byd_0_h_current = <3705>;
	q_max_neg_byd_10_h_current = <1282>;
	/* Discharge percentage, 1: D5, 0: D2 */
	oam_d5 = <1 >;

	change_tracking_point = <1 >;
	/* SW OCV tracking setting */
	cust_tracking_point = <1 >;
	cust_r_sense = <30>;
	cust_hw_cc = <0 >;
	aging_tuning_value = <103 >;
	cust_r_fg_offset = <0 >;
	ocv_board_compesate = <0 >;
	r_fg_board_base = <1000 >;
	r_fg_board_slope = <1000 >;
	car_tune_value = <100 >;

	/* HW Fuel gague  */
	current_detect_r_fg = <10 >;	/* Unit: mA */
	minerroroffset = <1000 >;
	fg_vbat_average_size = <18 >;
	r_fg_value = <10 >;	/* Unit: mOhm */

	cust_poweron_delta_capacity_tolrance = <80 >;
	cust_poweron_low_capacity_tolrance = <5 >;
	cust_poweron_max_vbat_tolrance = <90 >;
	cust_poweron_delta_vbat_tolrance = <30 >;
	cust_poweron_delta_hw_sw_ocv_capacity_tolrance = <10 >;

	/* Fixed battery temperature */
	fixed_tbat_25 = <0 >;
	/* Dynamic change wake up period of battery thread when suspend */
	vbat_normal_wakeup = <3600 >;	/* Unit: mV */
	vbat_low_power_wakeup = <3500 >;	/* Unit: mV */
	normal_wakeup_period = <5400 >;	/* Unit: second */
	low_power_wakeup_period = <300 >;	/* Unit: second */
	close_poweroff_wakeup_period = <30 >;	/* Unit: second */

	rbat_pull_up_r = <16900 >;
	rbat_pull_up_d = <27000 >;
	rbat_pull_up_volt = <1800 >;

	batt_temperature_table_num = <17 >;
	batt_temperature_table = <
			    (-20) 83104
			    (-15) 71753
			    (-10) 52118
			    (-5) 41188
			    0 31133
			    5 23751
			    10 18880
			    15 14872
			    20 12400
			    25 10561 30 8315 35 6948 40 5834 45 4917 50 4161 55 3535 60 3014 >;

	batt_temperature_table_byd_num = <17 >;
	batt_temperature_table_byd = <
			    (-20) 88104
			    (-15) 75753
			    (-10) 56118
			    (-5) 44188
			    0 31133
			    5 23751
			    10 18880
			    15 14872
			    20 12400
			    25 10561 30 8315 35 6948 40 5834 45 4917 50 4161 55 3535 60 3014 >;

	battery_profile_id0_t0_num = <102 >;
	battery_profile_id0_t0 = <0 4378 
				 1 4356 
				 2 4339 
				 3 4324 
				 4 4310 
				 5 4295 
				 6 4285 
				 7 4273 
				 8 4262 
				 9 4250 
				 10 4238 
				 11 4225 
				 12 4216 
				 13 4205 
				 14 4197 
				 15 4185 
				 16 4175 
				 17 4164 
				 18 4153 
				 19 4138 
				 20 4123 
				 21 4113 
				 22 4104 
				 23 4095 
				 24 4087 
				 25 4079 
				 26 4073 
				 27 4062 
				 28 4050 
				 29 4032 
				 30 4016 
				 31 4001 
				 32 3988 
				 33 3978 
				 34 3970 
				 35 3961 
				 36 3954 
				 37 3949 
				 38 3942 
				 39 3935 
				 40 3927 
				 41 3918 
				 42 3911 
				 43 3902 
				 44 3895 
				 45 3886 
				 46 3879 
				 47 3871 
				 48 3865 
				 49 3858 
				 50 3853 
				 51 3847  
				 52 3840 
				 53 3833 
				 54 3828 
				 55 3824 
				 56 3820 
				 57 3815 
				 58 3811 
				 59 3808 
				 60 3804 
				 61 3802 
				 62 3799 
				 63 3795 
				 64 3793 
				 65 3791 
				 66 3789 
				 67 3786 
				 68 3785 
				 69 3783 
				 70 3783 
				 71 3781 
				 72 3780 
				 73 3778 
				 74 3777 
				 75 3774 
				 76 3772 
				 77 3770 
				 78 3767 
				 79 3764 
				 80 3761 
				 81 3757 
				 82 3754 
				 83 3745  
				 84 3737 
				 85 3729 
				 86 3724 
				 87 3718 
				 88 3709 
				 89 3705 
				 90 3699 
				 91 3696 
				 92 3692 
				 93 3692 
				 94 3687 
				 95 3680 
				 96 3666 
				 97 3637 
				 98 3589 
				 99 3484 
				 100 3400 
				 100 3400 >;

	battery_profile_id0_t1_num = <102 >;
	battery_profile_id0_t1 = <0 4356
				1 4347
				2 4339
				3 4331
				4 4321
				5 4312
				6 4300
				7 4290
				8 4279
				9 4267
				10 4257
				11 4245
				12 4233
				13 4224
				14 4213
				15 4202
				16 4191
				17 4180
				18 4170
				19 4156
				20 4140
				21 4128
				22 4117
				23 4107
				24 4097
				25 4090
				26 4082
				27 4075
				28 4067
				29 4053
				30 4037
				31 4019
				32 4003
				33 3990
				34 3978
				35 3968
				36 3961
				37 3953
				38 3946
				39 3939
				40 3932
				41 3923
				42 3913
				43 3907
				44 3897
				45 3889
				46 3883
				47 3874
				48 3868
				49 3863
				50 3856
				51 3850
				52 3846
				53 3840
				54 3836
				55 3831
				56 3825
				57 3819
				58 3815
				59 3811
				60 3808
				61 3804
				62 3802
				63 3798
				64 3795
				65 3793
				66 3790
				67 3787
				68 3787
				69 3784
				70 3783
				71 3782
				72 3781
				73 3779
				74 3777
				75 3775
				76 3773
				77 3770
				78 3767
				79 3764
				80 3761
				81 3756
				82 3751
				83 3746
				84 3740
				85 3735
				86 3728
				87 3721
				88 3713
				89 3707
				90 3702
				91 3700
				92 3696
				93 3693
				94 3686
				95 3673
				96 3650
				97 3611
				98 3556
				99 3479
				100 3400
				100 3400
				>;

	battery_profile_id0_t2_num = <102 >;
	battery_profile_id0_t2 = <0 4388
				1 4374
				2 4363
				3 4351
				4 4338
				5 4329
				6 4320
				7 4307
				8 4293
				9 4284
				10 4273
				11 4262
				12 4249
				13 4238
				14 4221
				15 4206
				16 4191
				17 4183
				18 4172
				19 4161
				20 4151
				21 4140
				22 4127
				23 4117
				24 4108
				25 4099
				26 4087
				27 4079
				28 4070
				29 4064
				30 4055
				31 4044
				32 4028
				33 4015
				34 4004
				35 3995
				36 3990
				37 3984
				38 3978
				39 3971
				40 3964
				41 3956
				42 3945
				43 3931
				44 3911
				45 3900
				46 3889
				47 3881
				48 3872
				49 3868
				50 3862
				51 3856
				52 3850
				53 3845
				54 3839
				55 3835
				56 3831
				57 3828
				58 3823
				59 3818
				60 3815
				61 3812
				62 3807
				63 3805
				64 3802
				65 3798
				66 3796
				67 3793
				68 3790
				69 3787
				70 3785
				71 3782
				71 3779
				72 3775
				73 3771
				74 3769
				75 3763
				76 3762
				77 3758
				78 3753
				79 3749
				80 3746
				81 3742
				82 3738
				83 3732
				84 3727
				85 3722
				86 3717
				87 3711
				88 3701
				89 3694
				90 3691
				91 3691
				92 3690
				93 3689
				94 3688
				95 3684
				96 3675
				97 3645
				98 3569
				99 3458
				100 3400>;


	battery_profile_id0_t3_num = <102>;
	battery_profile_id0_t3 = <0 4368
				1 4359
				2 4344
				3 4334
				4 4325
				5 4317
				6 4306
				7 4295
				8 4282
				9 4268
				10 4255
				11 4245
				12 4234
				13 4224
				14 4211
				15 4194
				16 4183
				17 4170
				18 4155
				19 4147
				20 4136
				21 4127
				22 4119
				23 4108
				24 4098
				25 4088
				26 4074
				27 4066
				28 4054
				29 4045
				30 4035
				31 4029
				32 4021
				33 4010
				34 4002
				35 3991
				36 3983
				37 3975
				38 3965
				39 3959
				40 3953
				41 3947
				42 3938
				43 3921
				44 3899
				45 3889
				46 3879
				47 3869
				48 3865
				49 3859
				50 3853
				51 3847
				52 3839
				53 3833
				54 3833
				55 3826
				56 3821
				57 3819
				58 3811
				59 3807
				60 3804
				61 3799
				62 3797
				63 3795
				64 3791
				65 3786
				66 3785
				67 3783
				68 3777
				69 3775
				70 3772
				71 3770
				72 3763
				73 3750
				74 3749
				75 3745
				76 3741
				77 3735
				78 3729
				79 3725
				80 3722
				81 3720
				82 3715
				83 3714
				84 3709
				85 3701
				86 3696
				87 3689
				88 3678
				89 3673
				90 3671
				91 3671
				92 3672
				93 3673
				94 3670
				95 3667
				96 3655
				97 3626
				98 3581
				99 3525
				100 3400
				100 3400>;

	r_profile_id0_t0_num = <102>;
	r_profile_id0_t0 = <784 4378 
				 784 4356 
				 790 4339 
				 794 4324 
				 797 4310 
				 795 4295 
				 796 4285 
				 794 4273 
				 793 4262 
				 793 4250 
				 793 4238 
				 789 4225 
				 789 4216 
				 783 4205 
				 780 4197 
				 775 4185 
				 778 4175 
				 779 4164 
				 776 4153 
				 773 4138
				 769 4123 
				 769 4113 
				 770 4104 
				 771 4095 
				 771 4087 
				 768 4079 
				 765 4073 
				 760 4062 
				 794 4050 
				 794 4032 
				 790 4016 
				 785 4001 
				 781 3988 
				 780 3978 
				 778 3970 
				 777 3961 
				 778 3954 
				 778 3949 
				 775 3942 
				 767 3935 
				 763 3927 
				 758 3918 
				 761 3911 
				 759 3902 
				 758 3895 
				 754 3886 
				 753 3879 
				 751 3871 
				 750 3865 
				 749 3858 
				 751 3853 
				 749 3847 
				 746 3840  
				 745 3833 
				 744 3828 
				 749 3824 
				 748 3820 
				 748 3815 
				 746 3811 
				 749 3808 
				 748 3804 
				 754 3802 
				 755 3799 
				 755 3795 
				 755 3793 
				 754 3791 
				 752 3789 
				 753 3786 
				 756 3785 
				 760 3783 
				 763 3783 
				 765 3781 
				 767 3780 
				 771 3778 
				 776 3777 
				 779 3774 
				 783 3772 
				 787 3770 
				 789 3767 
				 790 3764 
				 795 3761 
				 803 3757 
				 807 3754 
				 820 3745  
				 830 3737 
				 838 3729 
				 851 3724 
				 864 3718 
				 876 3709 
				 893 3705 
				 906 3699 
				 926 3696 
				 944 3692 
				 975 3692 
				 1002 3687 
				 1042 3680 
				 1080 3666 
				 1111 3637 
				 1140 3589 
				 1136 3484 
				 1206 3400 
				 1221 3400>;

	r_profile_id0_t1_num = <102>;
	r_profile_id0_t1 = <
	      165  4356
				165  4347
				170  4339
				174  4331
				173  4321
				172  4312
				170  4300
				170  4290
				172  4279
				172  4267
				171  4257
				169  4245
				168  4233
				214  4224
				214  4213
				211  4202
				218  4191
				218  4180
				216  4170
				214  4156
				215  4140
				214  4128
				214  4117
				212  4107
				212  4097
				211  4090
				202  4082
				204  4075
				200  4067
				210  4053
				207  4037
				289  4019
				284  4003
				285  3990
				285  3978
				284  3968
				284  3961
				284  3953
				284  3946
				272  3939
				268  3932
				263  3923
				261  3913
				272  3907
				268  3897
				265  3889
				265  3883
				265  3874
				268  3868
				269  3863
				269  3856
				269  3850
				269  3846
				256  3840
				257  3836
				255  3831
				263  3827
				265  3825
				267  3815
				268  3811
				272  3808
				272  3804
				273  3802
				275  3798
				273  3795
				275  3793
				261  3790
				264  3787
				264  3787
				275  3784
				279  3783
				280  3782
				283  3781
				284  3779
				288  3777
				289  3775
				264  3773
				292  3770
				295  3767
				296  3764
				296  3761
				299  3756
				296  3751
				317  3746
				324  3740
				331  3735
				252  3728
				258  3721
				263  3713
				272  3707
				280  3702
				294  3700
				306  3696
				316  3693
				336  3686
				364  3673
				396  3650
				421  3611
				446  3556
				477  3479
				523  3400
				601  3400
	>;

	r_profile_id0_t2_num = <102 >;
	r_profile_id0_t2 = <117 4388
				117 4374
				115 4363
				115 4351
				116 4338
				116 4329
				119 4320
				119 4307
				115 4293
				119 4284
				118 4273
				119 4262
				117 4249
				119 4238
				120 4221
				122 4206
				114 4191
				117 4183
				118 4172
				118 4161
				120 4151
				121 4140
				117 4127
				119 4117
				121 4108
				123 4099
				121 4087
				125 4079
				125 4070
				130 4064
				128 4055
				128 4044
				127 4028
				122 4015
				124 4004
				122 3995
				126 3990
				127 3984
				125 3978
				125 3971
				126 3964
				128 3956
				124 3945
				122 3931
				117 3911
				115 3900
				111 3889
				111 3881
				107 3872
				110 3868
				109 3862
				109 3856
				107 3850
				107 3845
				108 3839
				111 3835
				109 3831
				110 3828
				110 3823
				107 3818
				111 3815
				109 3812
				109 3807
				112 3805
				111 3802
				111 3798
				114 3796
				113 3793
				113 3790
				114 3787
				114 3785
				114 3782
				113 3779
				112 3775
				111 3771
				114 3769
				110 3763
				110 3762
				111 3758
				109 3753
				108 3749
				111 3746
				111 3742
				110 3738
				108 3732
				111 3727
				112 3722
				112 3717
				112 3711
				111 3701
				112 3694
				109 3691
				112 3691
				111 3690
				114 3689
				119 3688
				121 3684
				122 3675
				119 3645
				123 3569
				129 3458
				147 3400>;

	r_profile_id0_t3_num = <102>;
	r_profile_id0_t3 = <85 4368
				85 4359
				80 4344
				77 4334
				81 4325
				84 4317
				78 4306
				79 4295
				78 4282
				76 4268
				78 4255
				81 4245
				81 4234
				80 4224
				82 4211
				79 4194
				81 4183
				80 4170
				81 4155
				86 4147
				82 4136
				83 4127
				84 4119
				80 4108
				82 4098
				84 4088
				81 4074
				86 4066
				83 4054
				86 4045
				84 4035
				89 4029
				85 4021
				84 4010
				88 4002
				85 3991
				90 3983
				90 3975
				88 3965
				97 3959
				95 3953
				94 3947
				92 3938
				89 3921
				85 3899
				85 3889
				82 3879
				76 3869
				82 3865
				79 3859
				78 3853
				79 3847
				75 3839
				78 3833
				84 3833
				78 3826
				78 3821
				82 3819
				75 3811
				78 3807
				80 3804
				79 3799
				83 3797
				83 3795
				81 3791
				80 3786
				84 3785
				84 3783
				81 3777
				84 3775
				82 3772
				85 3770
				81 3763 
				77 3750
				82 3749
				78 3745
				77 3741
				74 3735
				75 3729
				78 3725
				79 3722
				80 3720
				79 3715
				82 3714
				78 3709
				76 3701
				78 3696
				77 3689
				75 3678
				81 3673
				76 3671
				81 3671
				84 3672
				84 3673
				82 3670
				86 3667
				84 3655
				83 3626
				79 3581
				84 3525
				89 3400
				103 3400>;
				
//byd battery
				
	battery_profile_id1_t0_num = <60 >;
	battery_profile_id1_t0 = <			0  			4342
      2       4321
      3       4299
      5       4281
      7       4265
      8       4248
      10      4232
      12      4217
      14      4202
      15      4187
      17      4171
      19      4158
      20      4144
      22      4129
      24      4114
      25      4101
      27      4089
      29      4077
      31      4064
      32      4049
      34      4028
      36      4006
      37      3988
      39      3973
      41      3961
      42      3950
      44      3940
      46      3932
      47      3924
      49      3915
      51      3906
      53      3897
      54      3887
      56      3879
      58      3871
      59      3863
      61      3856
      63      3848
      64      3842
      66      3836
      68      3827
      69      3822
      71      3816
      73      3811
      75      3805
      76      3802
      78      3796
      80      3793
      81      3789
      83      3787
      85      3784
      86      3781
      88      3778
      90      3777
      92      3775
      93      3771
      95      3768
      97      3766
      98      3764
      100     3761>;

	battery_profile_id1_t1_num = <79 >;
	battery_profile_id1_t1 = <			0  			4360
      1       4352
      3       4335
      4       4320
      5       4304
      6       4289
      8       4273
      9       4259
      10      4244
      12      4229
      13      4215
      14      4201
      15      4187
      17      4173
      18      4159
      19      4146
      21      4132
      22      4119
      23      4105
      24      4092
      26      4082
      27      4073
      28      4060
      29      4043
      31      4022
      32      4003
      33      3987
      35      3975
      36      3964
      37      3955
      38      3944
      40      3935
      41      3924
      42      3914
      44      3903
      45      3893
      46      3882
      47      3873
      49      3864
      50      3857
      51      3850
      53      3842
      54      3836
      55      3829
      56      3823
      58      3818
      59      3813
      60      3808
      62      3805
      63      3800
      64      3796
      65      3792
      67      3790
      68      3787
      69      3783
      71      3780
      72      3778
      73      3777
      74      3775
      76      3771
      77      3771
      78      3768
      79      3765
      81      3762
      82      3759
      83      3756
      85      3750
      86      3744
      87      3738
      88      3732
      90      3725
      91      3716
      92      3707
      94      3699
      95      3694
      96      3689
      97      3686
      99      3680
      100     3668>;

	battery_profile_id1_t2_num = <85 >;
	battery_profile_id1_t2 = <			0  			4388
      1       4374
      2       4363
      3       4345
      4       4330
      5       4316
      6       4299
      7       4285
      8       4269
      9       4255
      10      4238
      11      4225
      12      4211
      14      4196
      15      4181
      16      4167
      17      4153
      18      4139
      20      4125
      21      4109
      22      4098
      23      4085
      25      4073
      26      4061
      27      4052
      28      4038
      29      4021
      31      4006
      32      3993
      33      3984
      34      3975
      36      3967
      37      3958
      38      3946
      39      3938
      41      3926
      42      3915
      43      3902
      44      3887
      45      3873
      47      3863
      48      3853
      49      3845
      50      3838
      52      3831
      53      3825
      54      3820
      55      3814
      57      3809
      58      3805
      59      3800
      60      3796
      61      3792
      63      3788
      64      3785
      65      3781
      66      3780
      68      3776
      69      3770
      70      3770
      71      3767
      72      3763
      74      3759
      75      3755
      76      3751
      77      3747
      79      3741
      80      3738
      81      3733
      82      3729
      84      3723
      85      3714
      86      3707
      87      3700
      88      3689
      90      3683
      91      3682
      92      3680
      93      3678
      95      3675
      96      3663
      97      3617
      98      3548
      99      3440
      100     3400>;


	battery_profile_id1_t3_num = <82>;
	battery_profile_id1_t3 = <			0  			4360
      1       4342
      2       4327
      4       4312
      5       4296
      6       4281
      7       4266
      9       4251
      10      4235
      11      4221
      12      4207
      14      4193
      15      4177
      16      4164
      17      4150
      19      4136
      20      4122
      21      4108
      22      4095
      24      4083
      25      4070
      26      4056
      27      4044
      29      4032
      30      4021
      31      4010
      32      3997
      34      3987
      35      3976
      36      3966
      37      3955
      39      3945
      40      3934
      41      3924
      42      3912
      43      3900
      45      3886
      46      3873
      47      3863
      48      3854
      50      3848
      51      3840
      52      3834
      53      3827
      55      3822
      56      3816
      57      3811
      58      3806
      60      3802
      61      3798
      62      3793
      63      3790
      65      3786
      66      3783
      67      3780
      68      3777
      70      3773
      71      3768
      72      3762
      73      3753
      75      3747
      76      3743
      77      3738
      78      3733
      80      3729
      81      3725
      82      3721
      83      3716
      85      3707
      86      3701
      87      3693
      88      3683
      89      3676
      91      3674
      92      3674
      93      3671
      94      3668
      96      3659
      97      3619
      98      3558
      99      3469
      101     3320>;

	r_profile_id1_t0_num = <60>;
	r_profile_id1_t0 = <			1015			4342 
      1015      4321
      998       4299
      985       4281
      970       4265
      953       4248
      938       4232
      928       4217
      915       4202
      903       4187
      893       4171
      883       4158
      875       4144
      865       4129
      858       4114
      848       4101
      843       4089
      840       4077
      838       4064
      835       4049
      817       4028
      800       4006
      788       3988
      778       3973
      780       3961
      775       3950
      773       3940
      775       3932
      773       3924
      770       3915
      768       3906
      768       3897
      763       3887
      765       3879
      765       3871
      763       3863
      768       3856
      765       3848
      773       3842
      773       3836
      773       3827
      775       3822
      775       3816
      780       3811
      783       3805
      790       3802
      790       3796
      798       3793
      800       3789
      810       3787
      813       3784
      818       3781
      825       3778
      838       3777
      845       3775
      853       3771
      860       3768
      880       3766
      898       3764
      918       3761>;

	r_profile_id1_t1_num = <79>;
	r_profile_id1_t1 = <116 	    4360 
      166       4352
      164       4335
      164       4320
      164       4304
      164       4289
      162       4273
      162       4259
      164       4244
      163       4229
      162       4215
      174       4201
      202       4187
      202       4173
      202       4159
      204       4146
      206       4132
      207       4119
      207       4105
      207       4092
      209       4082
      212       4073
      212       4060
      213       4043
      211       4022
      207       4003
      206       3987
      206       3975
      204       3964
      207       3955
      270       3944
      267       3935
      263       3924
      262       3914
      259       3903
      259       3893
      256       3882
      253       3873
      250       3864
      250       3857
      253       3850
      248       3842
      250       3836
      250       3829
      249       3823
      250       3818
      252       3813
      253       3808
      257       3805
      255       3800
      256       3796
      257       3792
      260       3790
      263       3787
      264       3783
      264       3780
      266       3778
      269       3777
      269       3775
      269       3771
      272       3771
      272       3768
      274       3765
      279       3762
      279       3759
      283       3756
      285       3750
      291       3744
      296       3738
      301       3732
      309       3725
      317       3716
      327       3707
      343       3699
      362       3694
      396       3689
      447       3686
      530       3680
      667       3668>;

	r_profile_id1_t2_num = <85 >;
	r_profile_id1_t2 = <			 108		   4388
       158       4374
       158       4363
       158       4345
       158       4330
       155       4316
       158       4299
       158       4285
       155       4269
       158       4255
       153       4238
       158       4225
       160       4211
       158       4196
       158       4181
       160       4167
       160       4153
       160       4139
       160       4125
       158       4109
       165       4098
       165       4085
       170       4073
       170       4061
       175       4052
       175       4038
       173       4021
       175       4006
       178       3993
       183       3984
       183       3975
       185       3967
       188       3958
       188       3946
       195       3938
       190       3926
       190       3915
       185       3902
       173       3887
       165       3873
       163       3863
       158       3853
       158       3845
       155       3838
       153       3831
       155       3825
       158       3820
       158       3814
       158       3809
       160       3805
       158       3800
       160       3796
       160       3792
       160       3788
       163       3785
       160       3781
       168       3780
       165       3776
       155       3770
       165       3770
       163       3767
       160       3763
       160       3759
       160       3755
       158       3751
       160       3747
       155       3741
       158       3738
       155       3733
       158       3729
       158       3723
       155       3714
       155       3707
       158       3700
       158       3689
       158       3683
       163       3682
       163       3680
       168       3678
       173       3675
       175       3663
       170       3617
       180       3548
       180       3442
       195       3400>;

	r_profile_id1_t3_num = <82>;
	r_profile_id1_t3 = <					83 			4360
         83        4342
         85        4327
         88        4312
         85        4296
         85        4281
         88        4266
         85        4251
         83        4235
         85        4221
         88        4207
         88        4193
         83        4177
         88        4164
         88        4150
         88        4136
         90        4122
         85        4108
         90        4095
         92        4083
         90        4070
         90        4056
         93        4044
         95        4032
         98        4021
         100       4010
         95        3997
         98        3987
         100       3976
         105       3966
         103       3955
         105       3945
         105       3934
         108       3924
         108       3912
         105       3900
         95        3886
         88        3873
         88        3863
         85        3854
         90        3848
         88        3840
         88        3834
         85        3827
         88        3822
         85        3816
         85        3811
         88        3806
         93        3802
         90        3798
         93        3793
         93        3790
         93        3786
         95        3783
         98        3780
         98        3777
         95        3773
         93        3768
         90        3762
         83        3753
         85        3747
         90        3743
         90        3738
         88        3733
         88        3729
         90        3725
         88        3721
         90        3716
         83        3707
         90        3701
         85        3693
         88        3683
         88        3676
         85        3674
         93        3674
         93        3671
         100       3668
         100       3659
         93        3619
         100       3558
         113       3469
         138       3320>;
};
